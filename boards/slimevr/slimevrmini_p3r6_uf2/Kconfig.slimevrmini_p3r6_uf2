## boards/slimevr/slimevrmini_p3r6_uf2/Kconfig.slimevrmini_p3r6_uf2
```kconfig
# Copyright (c) 2024 Nordic Semiconductor ASA
# SPDX-License-Identifier: Apache-2.0

config BOARD_SLIMEVRMINI_P3R6_UF2
	select SOC_NRF52833_QIAA
```

## i2c/Kconfig/Kconfig.shield.defconfig
```kconfig
osource "C:/Users/Lyall/Documents/GitHub/SlimeVR-Tracker-nRF/boards/shields/*/Kconfig.defconfig"
osource "C:/ncs/v3.1.0/nrf/boards/shields/*/Kconfig.defconfig"
```

## i2c/SlimeVR-Tracker-nRF/Kconfig/Kconfig.shield
```kconfig
osource "C:/Users/Lyall/Documents/GitHub/SlimeVR-Tracker-nRF/boards/shields/*/Kconfig.shield"
osource "C:/ncs/v3.1.0/nrf/boards/shields/*/Kconfig.shield"
```

## i2c/SlimeVR-Tracker-nRF/Kconfig/boards/Kconfig.defconfig
```kconfig
# Load Zephyr board defconfig descriptions.
osource "C:/Users/Lyall/Documents/GitHub/SlimeVR-Tracker-nRF/boards/nordic/promicro_uf2/Kconfig.defconfig"
```

## i2c/Stacked-SmolSlime/Kconfig/arch/Kconfig
```kconfig
# Load Zephyr Arch Kconfig descriptions.
osource "C:/ncs/v3.2.4/zephyr/arch/rx/Kconfig"
osource "C:/ncs/v3.2.4/zephyr/arch/x86/Kconfig"
osource "C:/ncs/v3.2.4/zephyr/arch/xtensa/Kconfig"
osource "C:/ncs/v3.2.4/zephyr/arch/sparc/Kconfig"
osource "C:/ncs/v3.2.4/zephyr/arch/riscv/Kconfig"
osource "C:/ncs/v3.2.4/zephyr/arch/posix/Kconfig"
osource "C:/ncs/v3.2.4/zephyr/arch/mips/Kconfig"
osource "C:/ncs/v3.2.4/zephyr/arch/arm64/Kconfig"
osource "C:/ncs/v3.2.4/zephyr/arch/arm/Kconfig"
osource "C:/ncs/v3.2.4/zephyr/arch/arc/Kconfig"
```
